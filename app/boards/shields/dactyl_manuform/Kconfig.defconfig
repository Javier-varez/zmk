## app/boards/shields/dactyl_manuform/Kconfig.defconfig
```kconfig
# Copyright (c) 2020 The ZMK Contributors
# SPDX-License-Identifier: MIT

if SHIELD_DACTYL_MANUFORM_LEFT

config ZMK_KEYBOARD_NAME
	default "dactyl-manuform"

config ZMK_SPLIT_ROLE_CENTRAL
	default y

endif

if SHIELD_DACTYL_MANUFORM_LEFT || SHIELD_DACTYL_MANUFORM_RIGHT

config ZMK_SPLIT
	default y

choice ZMK_SPLIT_TRANSPORT
	default ZMK_SPLIT_SERIAL
endchoice

endif
```

## app/boards/shields/dactyl_manuform/Kconfig.shield
```kconfig
# Copyright (c) 2020 The ZMK Contributors
# SPDX-License-Identifier: MIT

config SHIELD_DACTYL_MANUFORM
	def_bool $(shields_list_contains,dactyl-manuform)
```

## app/src/split/serial/Kconfig
```kconfig
if ZMK_SPLIT_SERIAL

menu "Serial Transport"

config ZMK_SPLIT_SERIAL_THREAD_STACK_SIZE
 	int "Serial split thread stack size"
 	default 1024

 config ZMK_SPLIT_SERIAL_THREAD_PRIORITY
 	int "Serial split thread priority"
 	default 5

 config ZMK_SPLIT_SERIAL_THREAD_QUEUE_SIZE
 	int "Max number of queue size for split data buffering"
 	default 5

endmenu

#ZMK_SPLIT_SERIAL
endif
```
